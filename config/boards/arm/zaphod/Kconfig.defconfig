## config/boards/arm/zaphod/Kconfig.defconfig
```kconfig
# Copyright (c) 2020 Pete Johanson
# SPDX-License-Identifier: MIT

if BOARD_ZAPHOD

config BOARD
	default "zaphod"

config ZMK_KEYBOARD_NAME
	default "Zaphod"

if USB

config USB_NRFX
	default y

config USB_DEVICE_STACK
	default y

endif # USB

config ZMK_DISPLAY
	select LVGL_USE_CONT
  # select FONT_CUSTOM_26

choice ZMK_DISPLAY_STATUS_SCREEN
	default ZMK_DISPLAY_STATUS_SCREEN_CUSTOM

endchoice

config ZMK_DISPLAY_STATUS_SCREEN_CUSTOM
	select LV_USE_LABEL
  select LV_OBJ_LABEL

if ZMK_DISPLAY

# choice LV_FONT_DEFAULT
#     default FONT_CUSTOM_26

# endchoice

# choice ZMK_LV_FONT_DEFAULT_SMALL
#     default FONT_CUSTOM_26

# endchoice

config SPI
	default y

config LS0XX
	default y

config LV_Z_BITS_PER_PIXEL
	default 1

choice LV_COLOR_DEPTH
	default LV_COLOR_DEPTH_1

endchoice

config LV_DPI_DEF
	default 30

config LV_Z_VDB_SIZE
	default 16

endif # ZMK_DISPLAY

menuconfig CUSTOM_WIDGET_BATTERY_STATUS
	bool "custom battery status widget"

menuconfig CUSTOM_WIDGET_OUTPUT_STATUS
	bool "custom output status widget"

menuconfig CUSTOM_WIDGET_LAYER_STATUS
	bool "custom layer status widget"

config BT_CTLR
	default BT

config ZMK_BLE
	default y

config ZMK_USB
	default y

config ZMK_BATTERY_VOLTAGE_DIVIDER
	default y

endif # BOARD_ZAPHOD
```

## config/boards/arm/zaphod/zaphod_defconfig
```kconfig
# SPDX-License-Identifier: MIT

CONFIG_SOC_SERIES_NRF52X=y
CONFIG_SOC_NRF52840_QIAA=y
CONFIG_BOARD_ZAPHOD=y

# Enable MPU
CONFIG_ARM_MPU=y

# enable GPIO
CONFIG_GPIO=y

# Sleep
CONFIG_ZMK_SLEEP=y

# Display
CONFIG_ZMK_DISPLAY=y
CONFIG_ZMK_DISPLAY_INVERT=y

CONFIG_LV_USE_THEME_MONO=y
CONFIG_LV_COLOR_CHROMA_KEY_HEX=0x00FF00

CONFIG_USE_DT_CODE_PARTITION=y
CONFIG_BUILD_OUTPUT_UF2=y

CONFIG_MPU_ALLOW_FLASH_WRITE=y
CONFIG_NVS=y
CONFIG_SETTINGS_NVS=y
CONFIG_FLASH=y
CONFIG_FLASH_PAGE_LAYOUT=y
CONFIG_FLASH_MAP=y

CONFIG_ZAPHOD_BONGO_CAT=y
CONFIG_ZMK_DISPLAY_WORK_QUEUE_DEDICATED=y

CONFIG_ZMK_KSCAN_DEBOUNCE_PRESS_MS=5
CONFIG_ZMK_KSCAN_DEBOUNCE_RELEASE_MS=10

# Custom status screen
CONFIG_ZMK_DISPLAY_STATUS_SCREEN_BUILT_IN=n
CONFIG_ZMK_DISPLAY_STATUS_SCREEN_CUSTOM=y

# Custom battery widget
CONFIG_CUSTOM_WIDGET_BATTERY_STATUS=y
CONFIG_ZMK_WIDGET_BATTERY_STATUS=n

# Custom output widget
CONFIG_CUSTOM_WIDGET_OUTPUT_STATUS=y
CONFIG_ZMK_WIDGET_OUTPUT_STATUS=n

# Custom layer widget
CONFIG_CUSTOM_WIDGET_LAYER_STATUS=y
CONFIG_ZMK_WIDGET_LAYER_STATUS=n

# # Turn on logging, and set ZMK logging to debug output
# CONFIG_LOG=y
# CONFIG_ZMK_LOG_LEVEL_DBG=y
# CONFIG_ZMK_USB_LOGGING=y
```

## config/boards/shields/hyperpotato/Kconfig.defconfig
```kconfig
# Copyright (c) 2023 Sviatoslav Bulbakha
# SPDX-License-Identifier: MIT

if SHIELD_HYPERPOTATO_LEFT

config ZMK_KEYBOARD_NAME
    default "hyperpotato"

config ZMK_SPLIT_ROLE_CENTRAL
    default y

endif

if SHIELD_HYPERPOTATO_LEFT || SHIELD_HYPERPOTATO_RIGHT
config ZMK_SPLIT
    default y
endif
```

## config/boards/shields/hyperpotato/Kconfig.shield
```kconfig
# Copyright (c) 2023 Sviatoslav Bulbakha
# SPDX-License-Identifier: MIT

config SHIELD_HYPERPOTATO_LEFT
    def_bool $(shields_list_contains,hyperpotato_left)

config SHIELD_HYPERPOTATO_RIGHT
    def_bool $(shields_list_contains,hyperpotato_right)
```

## config/boards/shields/kitsune/Kconfig.defconfig
```kconfig
# Copyright (c) 2020 Pete Johanson
# SPDX-License-Identifier: MIT

if SHIELD_KITSUNE

config ZMK_KEYBOARD_NAME
	default "Kitsune"

config SPI
	default y

config ZMK_DISPLAY
	select LVGL_USE_CONT
  # select FONT_CUSTOM_26

choice ZMK_DISPLAY_STATUS_SCREEN
	default ZMK_DISPLAY_STATUS_SCREEN_CUSTOM

endchoice

config ZMK_DISPLAY_STATUS_SCREEN_CUSTOM
	select LV_USE_LABEL
  select LV_OBJ_LABEL

if ZMK_DISPLAY

menuconfig KITSUNE_BONGO_CAT
    bool "Show WPM bongo cat"
    select ZMK_WPM
    select LV_USE_IMG
    select LV_USE_LABEL
    select LV_USE_ANIMIMG

if KITSUNE_BONGO_CAT

config KITSUNE_BONGO_CAT_IDLE_LIMIT
    int "Upper limit for WPM for showing idle animation"
    default 30

config KITSUNE_BONGO_CAT_SLOW_LIMIT
    int "Upper limit for WPM for showing slow typing image"
    default 60

endif # KITSUNE_BONGO_CAT



config SYSTEM_WORKQUEUE_STACK_SIZE
    default 2048

# choice LV_FONT_DEFAULT
#     default FONT_CUSTOM_26

# endchoice

# choice ZMK_LV_FONT_DEFAULT_SMALL
#     default FONT_CUSTOM_26

# endchoice

config LS0XX
	default y

config LV_Z_BITS_PER_PIXEL
	default 1

choice LV_COLOR_DEPTH
	default LV_COLOR_DEPTH_1

endchoice

config LV_DPI_DEF
	default 30

config LV_Z_VDB_SIZE
	default 16

endif # ZMK_DISPLAY

menuconfig CUSTOM_WIDGET_BATTERY_STATUS
	bool "custom battery status widget"

menuconfig CUSTOM_WIDGET_OUTPUT_STATUS
	bool "custom output status widget"

menuconfig CUSTOM_WIDGET_LAYER_STATUS
	bool "custom layer status widget"

endif # SHIELD_KITSUNE
```

## config/boards/shields/kitsune/Kconfig.shield
```kconfig
# Copyright (c) 2023 Sviatoslav Bulbakha
# SPDX-License-Identifier: MIT

config SHIELD_KITSUNE
   def_bool $(shields_list_contains,kitsune)
```

## config/boards/shields/kitsune/widgets/Kconfig
```kconfig
# Copyrigt (c) 2023 Sviatoslav Bulbakha
# SPDX-License-Identifier: MIT

menu "Kitsune Display Widgets"

config KITSUNE_WIDGET_LAYER_STATUS
    bool "Widget for highest, active layer using small icons"
    depends on !ZMK_SPLIT || ZMK_SPLIT_ROLE_CENTRAL
    select LV_USE_LABEL

config KITSUNE_WIDGET_BATTERY_STATUS
    bool "Widget for battery charge information, using small icons"
    depends on BT
    select LV_USE_LABEL

if KITSUNE_WIDGET_BATTERY_STATUS

config KITSUNE_WIDGET_BATTERY_STATUS_SHOW_PERCENTAGE
    bool "Show battery level percentage in text"

endif

config KITSUNE_WIDGET_OUTPUT_STATUS
    bool "Widget for keyboard output status icons"
    depends on BT && (!ZMK_SPLIT_BLE || ZMK_SPLIT_ROLE_CENTRAL)
    select LV_USE_LABEL

config KITSUNE_WIDGET_PERIPHERAL_STATUS
    bool "Widget for split peripheral status icons"
    depends on BT && ZMK_SPLIT_BLE && !ZMK_SPLIT_ROLE_CENTRAL
    select LV_USE_LABEL

config KITSUNE_WIDGET_WPM_STATUS
    bool "Widget for displaying typed words per minute"
    depends on !ZMK_SPLIT || ZMK_SPLIT_ROLE_CENTRAL
    select LV_USE_LABEL
    select ZMK_WPM

endmenu
```

## config/west.yml
```yaml
manifest:
  remotes:
    - name: zmkfirmware
      url-base: https://github.com/zmkfirmware
    - name: ssbb
      url-base: https://github.com/ssbb
  projects:
    - name: zmk
      remote: ssbb
      revision: main
      import: app/west.yml
  self:
    path: config
```
