/*
 * Copyright (c) 2023 Sviatoslav Bulbakha
 *
 * SPDX-License-Identifier: MIT
 */

#include "hyperpotato.dtsi" 

&kscan0 {
    col-gpios
        = <&pro_micro 14 GPIO_ACTIVE_HIGH> // COL0
        , <&pro_micro 15 GPIO_ACTIVE_HIGH> // COL1
        , <&pro_micro 18 GPIO_ACTIVE_HIGH> // COL2
        , <&pro_micro 19 GPIO_ACTIVE_HIGH> // COL3
        , <&pro_micro 20 GPIO_ACTIVE_HIGH> // COL4
        ;
};
